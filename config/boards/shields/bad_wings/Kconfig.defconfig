## config/boards/shields/bad_wings/Kconfig.defconfig
```kconfig
# Copyright (c) 2022 The ZMK Contributors
# SPDX-License-Identifier: MIT

if SHIELD_BAD_WINGS_DONGLE

config ZMK_KEYBOARD_NAME
    default "Bad Wings"

config ZMK_SPLIT_BLE_ROLE_CENTRAL
    default y

endif

if SHIELD_BAD_WINGS

config ZMK_SPLIT
    default y

endif
```
